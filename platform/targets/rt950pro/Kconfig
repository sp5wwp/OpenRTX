## platform/targets/rt950pro/Kconfig
```kconfig
# SPDX-FileCopyrightText: Copyright 2020-2026 OpenRTX Contributors
#
# SPDX-License-Identifier: GPL-3.0-or-later

config RT950PRO_DAC
	bool
	default y
	depends on BOARD_RT950PRO
	select USE_AT32_DAC
	select USE_AT32_TIMER
	select USE_AT32_ADC
	help
	  Artery HAL DAC, timer and ADC modules, for the audio output on DAC1
	  (PA4) timed by TMR6 and the bench recorder on ADC2.

config OPENRTX_CODEC2_MOD
	bool
	default y
	depends on BOARD_RT950PRO
	help
	  Use Codec2-mod (3200 bps mode only, fixed-size states) instead of the
	  reference Codec2: the reference decoder needs about 46 kB of heap and
	  stack, more than this target has free.
```

## west.yml
```yaml
# SPDX-License-Identifier: GPL-3.0-or-later
# SPDX-FileCopyrightText: Copyright 2020-2026 OpenRTX Contributors
#
# This file is part of OpenRTX.

manifest:
  self:
    path: OpenRTX

  defaults:
    remote: zephyr

  group-filter:
    - -csk6
    - -esp32
    - -artery

  remotes:
    - name: openrtx
      url-base: https://github.com/OpenRTX

    - name: zephyr
      url-base: https://github.com/zephyrproject-rtos

    - name: artery
      url-base: https://github.com/ArteryTek

    - name: marko13-dev
      url-base: https://github.com/Marko13-dev

  projects:
    # Zephyr mainline modules
    - name: zephyr
      remote: zephyr
      revision: a4de2eb3d1756c445d2e2ecb72e6d562674c118b
      path: zephyr
      west-commands: scripts/west-commands.yml
      groups:
        - esp32

    - name: mcuboot
      remote: zephyr
      revision: 9bf7ce8c5fe8152836a6e00bd4444153bd950342
      path: bootloader/mcuboot
      groups:
        - esp32

    - name: hal_espressif
      remote: zephyr
      revision: 80d910ca89eab9bce03f59a4ade33f1fc30ce0ad
      path: modules/hal/espressif
      west-commands: west/west-commands.yml
      groups:
        - esp32

    - name: cmsis
      remote: zephyr
      repo-path: cmsis
      revision: 74981bf893e8b10931464b9945e2143d99a3f0a3
      path: modules/hal/cmsis
      groups:
        - csk6

    # ListenAI fork-specific modules
    - name: listenai-zephyr
      remote: openrtx
      repo-path: listenai-zephyr
      revision: b8fcc47cc045871d5127a78a77b3f30feb65e8cd
      path: zephyr-listenai
      west-commands: scripts/west-commands.yml
      groups:
        - csk6

    - name: listenai-csk
      remote: openrtx
      repo-path: listenai-csk
      revision: f097b7f9dfe4aba9fae08af787230e023ee21aa0
      path: csk
      groups:
        - csk6

    - name: listenai-hal
      remote: openrtx
      repo-path: csk6_cm33
      revision: 9444f3dc2abec4d49e5daa6112a798ee43999222
      path: modules/hal/listenai/csk6_cm33
      groups:
        - csk6

    - name: listenai-modules-af
      remote: openrtx
      revision: openrtx-c62
      path: modules/lib/af
      groups:
        - csk6

    - name: listenai-modules-freertos_shims
      remote: openrtx
      revision: openrtx-c62
      path: modules/lib/freertos_shims
      groups:
        - csk6

    - name: listenai-modules-lsf
      remote: openrtx
      revision: openrtx-c62
      path: modules/lib/lsf
      groups:
        - csk6

    - name: listenai-modules-urpc
      remote: openrtx
      revision: openrtx-c62
      path: modules/lib/urpc
      groups:
        - csk6

    # Artery fork-specific modules (AT32F403A, Radtel RT-950 Pro).
    # Zephyr and hal_at32 include path-casing fixes for Linux filesystems.
    # CMSIS_6 matches the revision pinned by the Artery Zephyr fork itself.
    - name: artery-zephyr
      remote: marko13-dev
      repo-path: zephyr-artery
      revision: 2f81d3b5e2d0a9fe9b38f7076902cf93fc7062c3
      path: zephyr-artery
      west-commands: scripts/west-commands.yml
      groups:
        - artery

    - name: hal_at32
      remote: marko13-dev
      revision: e1ecf2f58bec14d9de06acd9afb00c79dfb13786
      path: modules/hal/at32
      groups:
        - artery

    - name: cmsis_6
      remote: zephyr
      repo-path: CMSIS_6
      revision: 30a859f44ef8ab4dc8f84b03ed586fd16ccf9d74
      path: modules/hal/cmsis_6
      groups:
        - artery
```
